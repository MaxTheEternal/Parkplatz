#include <Arduino.h>
namespace graph {

const int GRAPH_SIZE = 52;

bool graph[GRAPH_SIZE][GRAPH_SIZE]= {
{0,0,0,0,0,0,0,0,0,0,0,0,0,0,0,0,0,0,0,0,0,0,0,0,0,0,0,0,0,0,0,0,0,0,0,0,0,0,0,0,0,0,0,0,0,0,0,0,0,0,0,0},
{0,0,0,0,0,0,0,0,0,0,0,0,0,0,0,0,0,0,0,0,0,0,0,0,0,0,0,0,0,0,0,0,0,0,0,0,0,0,0,0,0,0,0,0,0,0,0,0,0,0,0,0},
{0,0,0,0,0,0,0,0,0,0,0,0,0,0,0,0,0,0,0,0,0,0,0,0,0,0,0,0,0,0,0,0,0,0,0,0,0,0,0,0,0,0,0,0,0,0,0,0,0,0,0,0},
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{0,0,0,0,0,0,0,0,0,1,1,0,0,0,0,0,0,0,0,0,0,0,0,0,0,0,0,0,0,0,0,0,0,0,0,0,0,0,0,0,0,0,0,0,0,0,0,0,0,0,0,0}
};


// BFS function
bool bfsWithPath(int start, int target, int path[], int &pathLength) {
    Serial.print("Graph started");
    // Initialize queue
    int queue[GRAPH_SIZE];
    int front = 0, rear = 0;
    
    // Initialize visited array
    bool visited[GRAPH_SIZE] = {false};
    
    // Parent array to reconstruct the path
    int parent[GRAPH_SIZE];
    for (int i = 0; i < GRAPH_SIZE; i++) parent[i] = -1;
    
    // Enqueue the starting node
    queue[rear++] = start;
    visited[start] = true;

    // BFS loop
    while (front < rear) {
    Serial.print("While");
        int currentNode = queue[front++];
        
        // Check if the target node is reached
        if (currentNode == target) {
            // Reconstruct the path
            int current = target;
            pathLength = 0;
            while (current != -1) {
                path[pathLength++] = current;
                current = parent[current];
            }
            // Reverse the path to get the correct order
            for (int i = 0; i < pathLength / 2; i++) {
                int temp = path[i];
                path[i] = path[pathLength - 1 - i];
                path[pathLength - 1 - i] = temp;
            }
            return true;
        }

        // Explore neighbors
        for (int neighbor = 0; neighbor < GRAPH_SIZE; neighbor++) {
            if (graph[currentNode][neighbor] && !visited[neighbor]) {
                visited[neighbor] = true;
                queue[rear++] = neighbor;
                parent[neighbor] = currentNode; // Track the path
            }
        }
    }

    // If we reach here, the target is not reachable
    return false;
}
}